## port/files/drivers/platform/msm/ipa/Kconfig
```kconfig
config IPA
	tristate "Qualcomm IP Accelerator (IPA) v2 driver"
	depends on ARCH_QCOM || COMPILE_TEST
	depends on SPS
	depends on NET
	select QCOM_QMI_HELPERS
	help
	  Qualcomm IP Accelerator (IPA) v2 driver. Used on Snapdragon SoCs
	  with integrated modem (e.g. SDM636/660 with IPA HW v2.6L) to
	  accelerate the data path between application processor and
	  modem subsystem (Q6 / MSS / MPSS).

	  This driver provides:
	   * Hardware-accelerated NAT/filter/routing/header processing
	   * QMI control plane to the modem (IPA_DRIVER_SVC)
	   * The /dev/ipa character device for IPACM userspace daemon
	   * The rmnet_ipa0 network device for cellular data

	  If unsure, say N.

config RMNET_IPA
	tristate "RmNet IPA network driver"
	depends on IPA
	select QCOM_RPROC_COMMON
	help
	  Provides rmnet_ipa0 netdev and /dev/wwan_ioctl character device
	  used by IPACM to install filter rules and query stats. Required
	  for cellular data through the IPA hardware accelerator.

	  This driver registers a QMI client/server pair that handshakes
	  with the modem's IPA driver counterpart over QRTR. After the
	  handshake completes, IPACM in userspace can install rules and
	  the modem starts pumping packets through rmnet_ipa0.

	  If unsure, say N.

config IPA_DEBUG
	bool "IPA debug verbose logging"
	depends on IPA
	help
	  Enables IPADBG and IPA_SONDA macros to emit verbose tracing
	  output via trace_printk(). Useful during bring-up.

	  If unsure, say N.

source "drivers/platform/msm/ipa/ipa_v2/Kconfig"
```

## port/files/drivers/platform/msm/ipa/ipa_v2/Kconfig
```kconfig
menu "IPA v2 components"
	depends on IPA

config IPA_TETH_BRIDGE
	bool "IPA tethering bridge support"
	depends on IPA
	default n
	help
	  USB tethering bridge between modem and APPS USB. Optional.
	  For just-modem-internet (cellular data on rmnet_ipa0) you do
	  not need this.

	  Adds teth_bridge_driver_init() into the probe path.

config IPA_UC_OFFLOAD_NTN
	bool "uC offload: Native Network Transport (NTN/Ethernet)"
	depends on IPA
	default n
	help
	  Enables the IPA microcontroller offload path for Ethernet
	  (NTN) protocol. Used for hardware-accelerated wired LAN
	  forwarding via the IPA uC firmware.

	  Not needed for cellular data through rmnet_ipa0.

config IPA_UC_OFFLOAD_WDI
	bool "uC offload: WLAN Data Interface (WDI/WDI3)"
	depends on IPA
	default n
	help
	  Enables the IPA microcontroller offload path for WLAN
	  acceleration. Used to offload TX/RX packet processing to
	  the IPA uC and bypass the host CPU for WiFi data.

	  Not needed for cellular data through rmnet_ipa0.

config IPA_MHI
	bool "IPA MHI client support"
	depends on IPA
	default n
	help
	  Modem Host Interface (MHI) client. For SoC variants with
	  internal modem (SDM636/660 etc.) this is not used; MHI is
	  primarily for external PCIe-attached modems.

	  Say N for SoC variants with integrated modem.

endmenu
```

## port/files/drivers/platform/msm/sps/Kconfig
```kconfig
config SPS
	tristate "Qualcomm Smart Peripheral Switch (SPS) BAM driver"
	depends on ARCH_QCOM || COMPILE_TEST
	help
	  Qualcomm SPS (Smart Peripheral Switch) framework. Manages BAM
	  (Bus Access Manager) peripherals. Required for IPA v2.

	  This driver coexists with mainline qcom_bam_dma (which only
	  supports BAM-to-system mode); SPS additionally supports BAM2BAM
	  peer-pipe transfers required by IPA <-> modem interconnect.

	  If unsure, say N.

config SPS_SUPPORT_BAMDMA
	bool "Include support for BAMDMA"
	depends on SPS
	default n
	help
	  Include support for BAMDMA. BAMDMA is a memory-to-memory DMA
	  engine that uses BAM. On modern SoCs (SDM660+) this is rarely
	  used and can stay disabled.

config SPS_SUPPORT_NDP_BAM
	bool "Support Non-Dedicated Pipe (NDP) BAM"
	depends on SPS
	default y
	help
	  Required for modern BAM HW used by IPA on SDM660 and similar.
	  Keep enabled.
```

## vendor-baseline-4.19/drivers/platform/msm/Kconfig
```kconfig
menu "Qualcomm MSM platform drivers"
source "drivers/platform/msm/sps/Kconfig"
source "drivers/platform/msm/ipa/Kconfig"
endmenu
```
